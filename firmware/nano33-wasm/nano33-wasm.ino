#include <wasm3.h>
#include <m3_env.h>

#ifdef REV2
#include <Arduino_BMI270_BMM150.h> // Biblioteca para o IMU (acelerômetro e giroscópio)
#else
#include <Arduino_LSM9DS1.h>
#endif

#include <Arduino_APDS9960.h>
#include <ArduinoBLE.h>

#define WASM_STACK_SLOTS    1024
#define NATIVE_STACK_SIZE   (32*1024)

#define FATAL(func, msg) { Serial.print("Fatal: " func " "); Serial.println(msg); while(1) { delay(100); } }
#define TSTART()         { tstart = micros(); }
#define TFINISH(s)       { tend = micros(); Serial.print(s " in "); Serial.print(tend-tstart); Serial.println(" us"); }

#define OFF 0
#define RED 1
#define GREEN 2
#define BLUE 3

uint16_t selectedProfile = 0; // selected profile by the APP

unsigned char app_wasm0[] = {
  0x00, 0x61, 0x73, 0x6d, 0x01, 0x00, 0x00, 0x00, 0x01, 0x35, 0x0a, 0x60,
  0x04, 0x7f, 0x7f, 0x7f, 0x7f, 0x01, 0x7f, 0x60, 0x00, 0x01, 0x7f, 0x60,
  0x02, 0x7f, 0x7f, 0x00, 0x60, 0x00, 0x00, 0x60, 0x01, 0x7f, 0x01, 0x7f,
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  0x00, 0x00, 0x02
};
unsigned int app_wasm_len0 = 5487;

unsigned char app_wasm1[] = {
  0x00, 0x61, 0x73, 0x6d, 0x01, 0x00, 0x00, 0x00, 0x01, 0x35, 0x0a, 0x60,
  0x04, 0x7f, 0x7f, 0x7f, 0x7f, 0x01, 0x7f, 0x60, 0x00, 0x01, 0x7f, 0x60,
  0x02, 0x7f, 0x7f, 0x00, 0x60, 0x00, 0x00, 0x60, 0x01, 0x7f, 0x01, 0x7f,
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  0x00, 0x00, 0x02
};
unsigned int app_wasm_len1 = 5487;

unsigned char app_wasm2[] = {
  0x00, 0x61, 0x73, 0x6d, 0x01, 0x00, 0x00, 0x00, 0x01, 0x35, 0x0a, 0x60,
  0x04, 0x7f, 0x7f, 0x7f, 0x7f, 0x01, 0x7f, 0x60, 0x00, 0x01, 0x7f, 0x60,
  0x02, 0x7f, 0x7f, 0x00, 0x60, 0x00, 0x00, 0x60, 0x01, 0x7f, 0x01, 0x7f,
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  0x00, 0x00, 0x02
};
unsigned int app_wasm_len2 = 5487;

BLEService configService("FFF0");
BLEIntCharacteristic profileCharacteristic("FFF1", BLERead | BLEWrite);

void advertisePacket(uint16_t frameCounter, uint32_t elapsedTime) {
    Serial.print("frameCounter: ");
    Serial.print(frameCounter);
    Serial.print(" elapsedTime: ");
    Serial.println(elapsedTime);

    // Set the advertising data
    BLEAdvertisingData advertisementData;

    // Manufacturer-specific data
    uint8_t manufacturerData[8];
    
    manufacturerData[0] = 0xFF;
    manufacturerData[1] = 0xCC;

    // Fill in manufacturer-specific data (elapsed time + frame counter)
    manufacturerData[2] = (uint8_t)(elapsedTime & 0xFF);
    manufacturerData[3] = (uint8_t)((elapsedTime >> 8) & 0xFF);
    manufacturerData[4] = (uint8_t)((elapsedTime >> 16) & 0xFF);
    manufacturerData[5] = (uint8_t)((elapsedTime >> 24) & 0xFF);

    manufacturerData[6] = (uint8_t)(frameCounter & 0xFF);
    manufacturerData[7] = (uint8_t)((frameCounter >> 8) & 0xFF);

    // Add the manufacturer data to the advertisement packet
    advertisementData.setManufacturerData(manufacturerData, sizeof(manufacturerData));

    // Configure BLE advertising
    BLE.setAdvertisingData(advertisementData);

    // Start advertising
    BLE.advertise();
}

m3ApiRawFunction(m3_adv_ble_ts) {
    m3ApiGetArg (uint32_t, frameCounter);
    m3ApiGetArg (uint32_t, elapsedTime);
    advertisePacket(frameCounter, elapsedTime);
    m3ApiSuccess();
}

m3ApiRawFunction(m3_adv_ble_stop) {
    BLE.stopAdvertise();
    m3ApiSuccess();
}

m3ApiRawFunction(m3_ble_pool) {
    BLE.poll();
    m3ApiSuccess();
}

m3ApiRawFunction(native_memcpy) {
    m3ApiGetArgMem  (uint8_t *, dst)
    m3ApiGetArgMem  (uint8_t *, src)
    m3ApiGetArgMem  (uint8_t *, dstend)

    do {
        *dst++ = *src++;
    } while (dst < dstend);

    m3ApiSuccess();
}

m3ApiRawFunction(m3_arduino_millis) {
  m3ApiReturnType (uint32_t)
  m3ApiReturn(millis());
}

m3ApiRawFunction(m3_arduino_delay) {
  m3ApiGetArg (uint32_t, ms)

  delay(ms);
  m3ApiSuccess();
}

// This maps pin modes from arduino_wasm_api.h
// to actual platform-specific values
uint8_t mapPinMode(uint8_t mode) {
  switch(mode) {
  case 0: return INPUT;
  case 1: return OUTPUT;
  case 2: return INPUT_PULLUP;
  }
  return INPUT;
}

m3ApiRawFunction(m3_arduino_pinMode) {
    m3ApiGetArg     (uint32_t, pin)
    m3ApiGetArg     (uint32_t, mode)
    pinMode(pin, (PinMode)mapPinMode(mode));
    m3ApiSuccess();
}

m3ApiRawFunction(m3_arduino_digitalWrite) {
    m3ApiGetArg     (uint32_t, pin)
    m3ApiGetArg     (uint32_t, value)
    digitalWrite(pin, value);
    m3ApiSuccess();
}

m3ApiRawFunction(m3_arduino_getPinLED) {
    m3ApiReturnType (uint32_t)
    m3ApiReturn(LED_BUILTIN);
}

m3ApiRawFunction(m3_arduino_getPinRedLED) {
    m3ApiReturnType (uint32_t)
    m3ApiReturn(LEDR);
}

m3ApiRawFunction(m3_arduino_getPinGreenLED) {
    m3ApiReturnType (uint32_t)
    m3ApiReturn(LEDG);
}

m3ApiRawFunction(m3_arduino_getPinBlueLED) {
    m3ApiReturnType (uint32_t)
    m3ApiReturn(LEDB);
}

m3ApiRawFunction(m3_arduino_print) {
    m3ApiGetArgMem  (const uint8_t *, buf)
    m3ApiGetArg     (uint32_t,        len)
    Serial.write(buf, len);
    m3ApiSuccess();
}

m3ApiRawFunction(m3_arduino_print_int) {
    m3ApiGetArg (uint32_t, i);
    Serial.println(i);
    m3ApiSuccess();
}

m3ApiRawFunction(m3_arduino_print_float) {
    m3ApiGetArg (float, i);
    Serial.println(i);
    m3ApiSuccess();
}

m3ApiRawFunction(m3_imu_gyro_read) {
    // m3ApiReturnType is void, but values can be written to the stack as needed.

    // Expecting that the Wasm module passes in the memory locations for x, y, and z.
    // These are pointers into the Wasm module's memory space, so we need to write the values there.

    m3ApiGetArgMem(float*, ret_x); // Get memory location for return value x
    m3ApiGetArgMem(float*, ret_y); // Get memory location for return value y
    m3ApiGetArgMem(float*, ret_z); // Get memory location for return value z

    float x = 0, y = 0, z = 0;
    
    // Check if the IMU gyroscope is available and read values
    if (IMU.gyroscopeAvailable()) {
        IMU.readGyroscope(x, y, z);
    }

    // Write the gyroscope readings into the Wasm memory locations
    *ret_x = x;
    *ret_y = y;
    *ret_z = z;

    // Return success
    m3ApiSuccess();
}

m3ApiRawFunction(m3_imu_mag_read) {
    // m3ApiReturnType is void, but values can be written to the stack as needed.

    // Expecting that the Wasm module passes in the memory locations for x, y, and z.
    // These are pointers into the Wasm module's memory space, so we need to write the values there.

    m3ApiGetArgMem(float*, ret_x); // Get memory location for return value x
    m3ApiGetArgMem(float*, ret_y); // Get memory location for return value y
    m3ApiGetArgMem(float*, ret_z); // Get memory location for return value z

    float x = 0, y = 0, z = 0;
    
    // Check if the IMU gyroscope is available and read values
    if (IMU.magneticFieldAvailable()) {
        IMU.readMagneticField(x, y, z);
    }

    // Write the gyroscope readings into the Wasm memory locations
    *ret_x = x;
    *ret_y = y;
    *ret_z = z;

    // Return success
    m3ApiSuccess();
}

m3ApiRawFunction(m3_imu_accel_read) {
    // m3ApiReturnType is void, but values can be written to the stack as needed.

    // Expecting that the Wasm module passes in the memory locations for x, y, and z.
    // These are pointers into the Wasm module's memory space, so we need to write the values there.

    m3ApiGetArgMem(float*, ret_x); // Get memory location for return value x
    m3ApiGetArgMem(float*, ret_y); // Get memory location for return value y
    m3ApiGetArgMem(float*, ret_z); // Get memory location for return value z

    float x = 0, y = 0, z = 0;
    
    // Check if the IMU gyroscope is available and read values
    if (IMU.accelerationAvailable()) {
        IMU.readAcceleration(x, y, z);
    }

    // Write the gyroscope readings into the Wasm memory locations
    *ret_x = x;
    *ret_y = y;
    *ret_z = z;

    // Return success
    m3ApiSuccess();
}

m3ApiRawFunction(m3_gesture_read) {
    uint32_t gesture = 4;
    if (APDS.gestureAvailable()) {
        gesture = APDS.readGesture();
    }
    m3ApiReturnType (uint32_t)
    m3ApiReturn(gesture);
}


IM3Environment  env;
IM3Runtime      runtime;
IM3Module       module;
IM3Function     func_run;
uint8_t*        mem;

void loadWasm() {
    M3Result result = m3Err_none;
    
    if (!env) {
      env = m3_NewEnvironment ();
      if (!env) FATAL("NewEnvironment", "failed");
    }

    m3_FreeRuntime(runtime);

    runtime = m3_NewRuntime (env, WASM_STACK_SLOTS, NULL);
    if (!runtime) FATAL("NewRuntime", "failed");

    unsigned char app;
    unsigned int len;

    switch (selectedProfile) {
        case 0:
            result = m3_ParseModule (env, &module, app_wasm0, app_wasm_len0);
            break;
        case 1:
            result = m3_ParseModule (env, &module, app_wasm1, app_wasm_len1);
            break;
        case 2:
            result = m3_ParseModule (env, &module, app_wasm1, app_wasm_len2);
            break;
        default:
            result = m3_ParseModule (env, &module, app_wasm0, app_wasm_len0);
            break;
    }

    if (result) FATAL("ParseModule", result);

    result = m3_LoadModule (runtime, module);
    if (result) FATAL("LoadModule", result);

    const char* arduino = "arduino";

    m3_LinkRawFunction (module, arduino, "memcpy",           "v(iii)", &native_memcpy);
    m3_LinkRawFunction (module, arduino, "millis",           "i()",    &m3_arduino_millis);
    m3_LinkRawFunction (module, arduino, "delay",            "v(i)",   &m3_arduino_delay);
    m3_LinkRawFunction (module, arduino, "pinMode",          "v(ii)",  &m3_arduino_pinMode);
    m3_LinkRawFunction (module, arduino, "digitalWrite",     "v(ii)",  &m3_arduino_digitalWrite);
    m3_LinkRawFunction (module, arduino, "getPinLED",        "i()",    &m3_arduino_getPinLED);

    m3_LinkRawFunction (module, arduino, "getPinRedLED",     "i()",    &m3_arduino_getPinRedLED);
    m3_LinkRawFunction (module, arduino, "getPinGreenLED",   "i()",    &m3_arduino_getPinGreenLED);
    m3_LinkRawFunction (module, arduino, "getPinBlueLED",    "i()",    &m3_arduino_getPinBlueLED);

    m3_LinkRawFunction (module, arduino, "print",            "v(*i)",  &m3_arduino_print);
    m3_LinkRawFunction (module, arduino, "printInt",         "v(i)",   &m3_arduino_print_int);
    m3_LinkRawFunction (module, arduino, "printFloat",       "v(f)",   &m3_arduino_print_float);
    m3_LinkRawFunction (module, arduino, "imuGyroRead",      "v(***)", &m3_imu_gyro_read);
    m3_LinkRawFunction (module, arduino, "imuMagRead",       "v(***)", &m3_imu_mag_read);
    m3_LinkRawFunction (module, arduino, "imuAccelRead",     "v(***)", &m3_imu_accel_read);
    m3_LinkRawFunction (module, arduino, "gestureRead",      "v(i)",   &m3_gesture_read);

    m3_LinkRawFunction (module, arduino, "advBLETs", "v(ii)", &m3_adv_ble_ts);
    m3_LinkRawFunction (module, arduino, "stopAdvBLE", "v()", &m3_adv_ble_stop);
    m3_LinkRawFunction (module, arduino, "blePool", "v()", &m3_ble_pool);

    mem = m3_GetMemory (runtime, NULL, 0);
    if (!mem) FATAL("GetMemory", "failed");

    result = m3_FindFunction (&func_run, runtime, "_start");
    if (result) FATAL("FindFunction", result);
} 

void setRGB(uint8_t color) {
    switch (color) {
        case OFF:
            digitalWrite(LEDR, HIGH);
            digitalWrite(LEDG, HIGH);
            digitalWrite(LEDB, HIGH);
            break;
        case RED:
            digitalWrite(LEDR, LOW);
            digitalWrite(LEDG, HIGH);
            digitalWrite(LEDB, HIGH);
            break;
        case GREEN:
            digitalWrite(LEDR, HIGH);
            digitalWrite(LEDG, LOW);
            digitalWrite(LEDB, HIGH);
            break;
        case BLUE:
            digitalWrite(LEDR, HIGH);
            digitalWrite(LEDG, HIGH);
            digitalWrite(LEDB, LOW);
            break;
        default:
            digitalWrite(LEDR, LOW);
            digitalWrite(LEDG, LOW);
            digitalWrite(LEDB, LOW);
            break;
    }
}

long configProcessPrevMillis = 0;  // last time the cycle time was checked, in ms

void selectProfile(uint16_t profileId) {
    if (profileId >= 3) {
        return;
    }
    selectedProfile = profileId;
}

void configProcess() {
    // start advertising
    BLE.advertise();

    Serial.println("Bluetooth® device active, waiting for connections...");

    bool on = false;

    while (true) {
        long currentMillis = millis();

        // if 200ms have passed, update the cycle time:
        if (currentMillis - configProcessPrevMillis >= 500) {
            configProcessPrevMillis = currentMillis;
            Serial.println(".");
            if (on) {
                setRGB(BLUE);
            } else {
                setRGB(OFF);
            }

            on = !on;
        }

        // wait for a Bluetooth® Low Energy central
        BLEDevice central = BLE.central();

        // if a central is connected to the peripheral:
        if (central) {
            setRGB(BLUE);

            // while the central is connected:
            while (central.connected()) {
                if (profileCharacteristic.written()) {
                    // Read the value that was written by the central
                    byte value = profileCharacteristic.value();
                    uint16_t profile = (uint16_t)value;

                    // Do something with the value
                    Serial.print("Profile configured by central to: ");
                    Serial.println(profile);

                    selectProfile(profile);
                    setRGB(GREEN);
                    return;
                }
            }
        }
    }
}

void initDevice() {
    Serial.println("initDevice called");
    pinMode(LED_BUILTIN, OUTPUT);
    digitalWrite(LED_BUILTIN, LOW);
    
    pinMode(LEDR, OUTPUT);
    pinMode(LEDG, OUTPUT);
    pinMode(LEDB, OUTPUT);
    setRGB(OFF);

    //Init gyroscope, accelaration, magnetometer
    if (!IMU.begin()) {
        Serial.println("Failed to initialize IMU!");
        while(1);
    }

    if (!APDS.begin()) {
        Serial.println("Failed to initialize motion sensor!");
        while(1);
    }

    if (!BLE.begin()) {
        Serial.println("failed to initialize BLE!");
        while (1);
    }

    BLE.setDeviceName("CHEETOS-FINGERS");
    BLE.setLocalName("CHEETOS-FINGERS");

    BLE.setAdvertisedService(configService); // add service UUID
    configService.addCharacteristic(profileCharacteristic); // add the cycle time characteristic
    BLE.addService(configService); // Add the cycle time service

    Serial.println("initDevice ended");
}

void setup() {
    Serial.begin(115200);
    delay(100);

    // Wait for serial port to connect
    // Needed for native USB port only
    // while(!Serial) {}

    Serial.println("setup started");

    uint32_t tend, tstart;
    TSTART();
      initDevice();
    TFINISH("Device init");

    TSTART();
      configProcess();
    TFINISH("Config process");
    
    TSTART();
      loadWasm();
    TFINISH("Wasm3 init");

    Serial.println("Running WebAssembly...");

    wasm_task(NULL);
}

void wasm_task(void*) {
    M3Result result;

    while (true) {
        const uint64_t framestart = micros();

        result = m3_CallV (func_run);
        if (result) break;
    }

    if (result != m3Err_none) {
        M3ErrorInfo info;
        m3_GetErrorInfo (runtime, &info);
        Serial.print("Error: ");
        Serial.print(result);
        Serial.print(" (");
        Serial.print(info.message);
        Serial.println(")");
        if (info.file && strlen(info.file) && info.line) {
            Serial.print("At ");
            Serial.print(info.file);
            Serial.print(":");
            Serial.println(info.line);
        }
    }
}

void loop() { // should never reach
    delay(100);
}